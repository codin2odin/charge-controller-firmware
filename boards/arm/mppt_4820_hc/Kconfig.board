## boards/arm/mppt_4820_hc/Kconfig.board
```kconfig
# Copyright (c) The Libre Solar Project Contributors
# SPDX-License-Identifier: Apache-2.0

config BOARD_MPPT_4820_HC
	bool "Libre Solar MPPT 4820 HC"
	depends on SOC_STM32G431XX
```

## boards/arm/mppt_4820_hc/Kconfig.defconfig
```kconfig
# Copyright (c) The Libre Solar Project Contributors
# SPDX-License-Identifier: Apache-2.0

if BOARD_MPPT_4820_HC

config BOARD
	default "mppt_4820_hc"

config LIBRE_SOLAR_TYPE_ID
	default 8

endif # BOARD_MPPT_4820_HC
```
